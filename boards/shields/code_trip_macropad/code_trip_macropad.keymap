#include <behaviors.dtsi>
#include <dt-bindings/zmk/keys.h>

/ {
    keymap {
        compatible = "zmk,keymap";

        default_layer {
            bindings = <
                &kp F13  &kp F14  &kp F15  &kp F16  &kp F17
            >;
        };
    };
};
