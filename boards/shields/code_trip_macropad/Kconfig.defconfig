## boards/shields/code_trip_macropad/Kconfig.defconfig
```kconfig
if SHIELD_CODE_TRIP_MACROPAD

config ZMK_KEYBOARD_NAME
    default "Code Trip Macro"

endif
```

## boards/shields/code_trip_macropad/Kconfig.shield
```kconfig
config SHIELD_CODE_TRIP_MACROPAD
    def_bool $(shields_list_contains,code_trip_macropad)
```
